RCC_APB2ENR EQU 0x40021018	
	
GPIOA_CRL	EQU 0x40010800
GPIOA_CRH	EQU 0x40010804
GPIOA_IDR	EQU 0x40010808
GPIOA_ODR	EQU 0x4001080C

GPIOB_CRL	EQU 0x40010C00
GPIOB_CRH	EQU 0x40010C04
GPIOB_IDR	EQU 0x40010C08
GPIOB_ODR	EQU 0x40010C0C

	AREA myData, DATA, READONLY
;Lenh, xem bang
setup DCB 0x58, 0xE, 0x1
;KHONG XOA 0x0
data DCB 0x0
thay_Khoa DCB 0x74, 0x68, 0x61, 0x79, 0x8, 0x4B, 0x68, 0x6F, 0x61	
dep_zai DCB 0x8, 0x64, 0x65, 0x70, 0x8, 0x7A, 0x61, 0x69
SUPER DCB 0x8,0x8, 0x53, 0x55, 0x50, 0x45, 0x52
dep_zai2 DCB 0x8, 0x64, 0x65, 0x70, 0x8, 0x7A, 0x61, 0x69
so_1_UTE DCB 0x8,0x73, 0x6F, 0x31, 0x55, 0x54, 0x45

	
	AREA MAIN, CODE, READONLY
	EXPORT __main
__main
	;ENABLE CLOCK
	LDR	R1,=RCC_APB2ENR
	LDR R0,[R1]			
	ORR R0,R0,#0xFC		
	STR R0,[R1]			
	
	;SET UP GPIOB
	LDR R1,=GPIOB_CRL
	LDR R0,=0x33333333	
	STR R0,[R1]			
	LDR R1,=GPIOB_CRH
	LDR R0,=0x33
	STR R0,[R1]			
	
	;SET UP LCD
	LDR R5, =setup
SET_UP
	LDRB R3, [R5]
	CMP R3, #0x0
	BNE CONGG
	CMP R3, #0x0
	BEQ OUT_setup
CONGG
	BL GHI_LENH
	ADD R5, R5, #1
tiepp	
	B SET_UP
	
OUT_setup
	;DATA
	LDR R4, =data
LOOP
	LDRB R0, [R4]
	CMP R0, #0xFF
	BNE CONG
	CMP R0, #0xFF
	BEQ S
	B tiep
	
CONG
	BL GHI_DATA
	ADD R4, R4, #1
tiep
	B LOOP
	

GHI_LENH
	PUSH {LR}
	
	LDR R1,=GPIOB_ODR
	ADD R3, R3, #0x200
	STR R3,[R1]
	
	BL delay
	
	SUB R3, R3, #0x200
	LDR R1,=GPIOB_ODR
	STR R3,[R1]
	
	BL delay
	POP{LR}
	
	BX LR

GHI_DATA
	PUSH {LR}
	
	LDR R1,=GPIOB_ODR
	ADD R0, R0, #0x300
	STR R0,[R1]
	
	BL delay
	
	SUB R0, R0, #0x200
	LDR R1,=GPIOB_ODR
	STR R0,[R1]
	
	BL delay
	POP{LR}
	
	BX LR
	
	
delay
	LDR R6,= 2
d_L1	LDR R7,= 10000
d_L2	SUBS R7,R7,#1		
		BNE	d_L2			
		SUBS R6,R6,#1
		BNE d_L1
		BX	LR	

S B S		
		END